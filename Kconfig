## Kconfig
```kconfig
# SPDX-License-Identifier: GPL-2.0-only
config MT76x8U
	tristate "MediaTek MT7668U (USB) support"
	depends on MAC80211
	depends on USB
	help
	  This adds support for MT7668U-based wireless USB dongles.
```
